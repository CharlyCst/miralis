## misc/visionfive2.its
```
/dts-v1/;

/ {
        description = "U-boot-spl FIT image for JH7110 VisionFive2";
        #address-cells = <2>;

        images {
                firmware {
                        description = "miralis";
                        data = /incbin/("../target/riscv-unknown-miralis/debug/miralis.img");
                        type = "firmware";
                        os = "u-boot";
                        load = <0x0 0x43000000>;
                        entry = <0x0 0x43000000>;
                        compression = "none";
                };

                virtual-firmware {
                        description = "virtual firmware";
                        data = /incbin/("../fw_payload.bin");
                        type = "firmware";
                        arch = "riscv";
                        load = <0x0 0x40000000>;
                        compression = "none";
                };
        };

    configurations {
        default = "config-1";

        config-1 {
            description = "U-boot-spl FIT config for JH7110 VisionFive2";
            firmware = "firmware";
            loadables = "virtual-firmware";
        };
    };
};
```

## visionfive2-fit-image-fast.its
```
/dts-v1/;

/ {
        description = "U-boot-spl FIT image for JH7110 VisionFive2";
        #address-cells = <2>;

        images {
                firmware {
                        description = "miralis";
                        data = /incbin/("./target/riscv-unknown-miralis/debug/miralis.img");
                        type = "firmware";
                        os = "u-boot";
                        load = <0x0 0x43000000>;
                        entry = <0x0 0x43000000>;
                        compression = "none";
                };

                opensbi {
                        description = "opensbi";
                        data = /incbin/("../opensbi/build/platform/generic/firmware/fw_jump.bin");
                        type = "firmware";
                        arch = "riscv";
                        load = <0x0 0x40000000>;
                        compression = "none";
                };

                u-boot {
                        description = "u-boot";
                        data = /incbin/("../u-boot/u-boot.bin");
                        type = "firmware";
                        arch = "riscv";
                        load = <0x0 0x40200000>;
                        compression = "none";
                };
        };

        configurations {
            default = "config-1";

            config-1 {
                description = "U-boot-spl FIT config for JH7110 VisionFive2";
                firmware = "firmware";
                loadables = "opensbi", "u-boot";
            };
        };
};
```
